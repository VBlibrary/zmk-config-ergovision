## app/boards/shields/rgovision/Kconfig.defconfig
```kconfig
# Copyright (c) 2022 ZMK Contributors
# SPDX-License-Identifier: MIT
if SHIELD_RGOVISION

config ZMK_KEYBOARD_NAME
    default "rgovision"

CONFIG_PINNACLE=y
CONFIG_PINNACLE_TRIGGER_OWN_THREAD=y
CONFIG_ZMK_MOUSE=y
CONFIG_ZMK_SLEEP=y
CONFIG_ZMK_IDLE_SLEEP_TIMEOUT=420000
CONFIG_ZMK_POINTER=y

CONFIG_I2C=y
CONFIG_I2C_0=y
CONFIG_I2C_NRFX=y

CONFIG_BT_PERIPHERAL_PREF_MIN_INT=6
CONFIG_BT_PERIPHERAL_PREF_MAX_INT=12
CONFIG_ZMK_BEHAVIORS_QUEUE_SIZE=128

endif 
```

## app/boards/shields/rgovision/Kconfig.shield
```kconfig
# Copyright (c) 2020 ZMK Contributors
# SPDX-License-Identifier: MIT

config SHIELD_RGOVISION
	def_bool $(shields_list_contains,rgovision)
```

## app/dts/bindings/behaviors/cirque,trackpad.yml
```yaml
# SPDX-License-Identifier: Apache-2.0

description: |
  Binding for Cirque trackpads.

compatible: "cirque,trackpad"

properties:
  reg:
    required: true
    description: I2C address of the device.

  int-gpios:
    type: phandle-array
    required: false
    description: GPIO specifier for the interrupt pin.

  dr-gpios:
    type: phandle-array
    description: GPIO specifier for the DR pin.

  label:
    required: true
    type: string
    description: Human-readable string describing the device.
```

## app/west.yml
```yaml
manifest:
  remotes:
    - name: zmkfirmware
      url-base: https://github.com/zmkfirmware
    - name: badjeff
      url-base: https://github.com/badjeff
  
  self:
    path: config
```

## config/boards/shields/ergovision/Kconfig.defconfig
```kconfig
# Copyright (c) 2022 ZMK Contributors
# SPDX-License-Identifier: MIT
 
 
if SHIELD_ERGOVISION_LEFT

config ZMK_KEYBOARD_NAME
	default "ergovision_left"

endif

if SHIELD_ERGOVISION_RIGHT

config ZMK_KEYBOARD_NAME
	default "ErgoVision"

config ZMK_SPLIT_ROLE_CENTRAL
	default y
	
endif

if SHIELD_ERGOVISION_LEFT || SHIELD_ERGOVISION_RIGHT

config ZMK_SPLIT
	default y
config ZMK_BLE
    default y
endif
```

## config/boards/shields/ergovision/Kconfig.shield
```kconfig
# Copyright (c) 2020 ZMK Contributors
# SPDX-License-Identifier: MIT

config SHIELD_ERGOVISION_LEFT
	def_bool $(shields_list_contains,ergovision_left)

config SHIELD_ERGOVISION_RIGHT
	def_bool $(shields_list_contains,ergovision_right)
```

## config/boards/shields/rgovision/Kconfig.defconfig
```kconfig
# Copyright (c) 2022 ZMK Contributors
# SPDX-License-Identifier: MIT
if SHIELD_RGOVISION

config ZMK_KEYBOARD_NAME
    default "rgovision"


CONFIG_ZMK_MOUSE=y
CONFIG_ZMK_SLEEP=y
CONFIG_ZMK_IDLE_SLEEP_TIMEOUT=420000
CONFIG_I2C=y
CONFIG_ZMK_MOUSE=y
CONFIG_INPUT=y
CONFIG_INPUT_PINNACLE=y
endif 
```

## config/west.yml
```yaml
manifest:
  remotes:
    - name: zephyrproject-rtos
      url-base: https://github.com/zephyrproject-rtos
    - name: zmkfirmware
      url-base: https://github.com/zmkfirmware
    - name: krikun98
      url-base: https://github.com/krikun98
    - name: crides
      url-base: https://github.com/crides

  projects:
    - name: zephyr
      remote: zmkfirmware
      revision: v3.0.0+zmk-fixes
      clone-depth: 1
      import:
        name-blocklist:
          - ci-tools
          - hal_altera
          - hal_cypress
          - hal_infineon
          - hal_microchip
          - hal_nxp
          - hal_openisa
          - hal_silabs
          - hal_xtensa
          - hal_st
          - hal_ti
          - loramac-node
          - mcuboot
          - mcumgr
          - net-tools
          - openthread
          - edtt
          - trusted-firmware-m
          - sof

    - name: zmk
      remote: krikun98
      revision: mouse-pr
      path: modules/krikun98-zmk

  self:
    west-commands: scripts/west-commands.yml
```
