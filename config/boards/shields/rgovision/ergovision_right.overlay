
#include "ergovision.dtsi"

   &default_transform {
    col-offset = <6>;
};

&kscan0 {
        col-gpios  
           = <&gpio0 4 (GPIO_ACTIVE_HIGH | GPIO_PULL_DOWN)>
           , <&gpio0 5 (GPIO_ACTIVE_HIGH | GPIO_PULL_DOWN)>
           , <&gpio0 6 (GPIO_ACTIVE_HIGH | GPIO_PULL_DOWN)>
           , <&gpio0 7 (GPIO_ACTIVE_HIGH | GPIO_PULL_DOWN)>
           , <&gpio0 8 (GPIO_ACTIVE_HIGH | GPIO_PULL_DOWN)>
           , <&gpio0 9 (GPIO_ACTIVE_HIGH | GPIO_PULL_DOWN)> 
           ; 
};
